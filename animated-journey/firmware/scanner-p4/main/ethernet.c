#include <string.h>
#include "freertos/FreeRTOS.h"
#include "freertos/event_groups.h"
#include "esp_log.h"
#include "esp_event.h"
#include "esp_netif.h"
#include "esp_eth.h"
#include "esp_eth_mac.h"
#include "esp_eth_phy.h"
#include "driver/gpio.h"
#include "ethernet.h"

static const char *TAG = "ethernet";

/*
 * ESP32-P4-NANO Ethernet pin mapping (IP101GRI PHY, RMII):
 *
 *   TXD0    = GPIO34      RXD0    = GPIO29
 *   TXD1    = GPIO35      RXD1    = GPIO30
 *   TX_EN   = GPIO49      CRS_DV  = GPIO28
 *   REF_CLK = GPIO50      MDC     = GPIO31
 *   (from PHY crystal)    MDIO    = GPIO52
 *                          PHY_RST = GPIO51
 *
 * RMII data-plane GPIOs match ETH_ESP32_EMAC_DEFAULT_CONFIG() for P4.
 * REF_CLK is generated by the PHY's 25 MHz crystal (EMAC_CLK_EXT_IN on GPIO50, also the default).
 * PHY address auto-detected (-1); R75 pulls PHYAD0 high so expect address 1.
 */

#define ETH_PHY_ADDR       (-1)
#define ETH_PHY_RST_GPIO   51
#define ETH_MDC_GPIO       31
#define ETH_MDIO_GPIO      52

static EventGroupHandle_t s_eth_event_group;
#define ETH_CONNECTED_BIT  BIT0

static ethernet_ip_callback_t s_ip_callback = NULL;
static bool s_has_ip = false;

static void eth_event_handler(void *arg, esp_event_base_t event_base,
                              int32_t event_id, void *event_data)
{
    switch (event_id) {
    case ETHERNET_EVENT_CONNECTED:
        ESP_LOGI(TAG, "Ethernet link up");
        break;
    case ETHERNET_EVENT_DISCONNECTED:
        ESP_LOGW(TAG, "Ethernet link down");
        s_has_ip = false;
        xEventGroupClearBits(s_eth_event_group, ETH_CONNECTED_BIT);
        break;
    default:
        break;
    }
}

static void got_ip_event_handler(void *arg, esp_event_base_t event_base,
                                 int32_t event_id, void *event_data)
{
    ip_event_got_ip_t *event = (ip_event_got_ip_t *)event_data;
    ESP_LOGI(TAG, "Got IP: " IPSTR, IP2STR(&event->ip_info.ip));
    s_has_ip = true;
    xEventGroupSetBits(s_eth_event_group, ETH_CONNECTED_BIT);

    if (s_ip_callback) {
        s_ip_callback();
    }
}

void ethernet_set_ip_callback(ethernet_ip_callback_t cb)
{
    s_ip_callback = cb;
    if (s_has_ip && cb) {
        cb();
    }
}

bool ethernet_wait_for_ip(int timeout_ms)
{
    if (s_has_ip) {
        return true;
    }
    EventBits_t bits = xEventGroupWaitBits(s_eth_event_group, ETH_CONNECTED_BIT,
                                           pdFALSE, pdFALSE, pdMS_TO_TICKS(timeout_ms));
    return (bits & ETH_CONNECTED_BIT) != 0;
}

bool ethernet_has_ip(void)
{
    return s_has_ip;
}

esp_err_t ethernet_init(void)
{
    s_eth_event_group = xEventGroupCreate();

    ESP_ERROR_CHECK(esp_netif_init());
    ESP_ERROR_CHECK(esp_event_loop_create_default());

    esp_netif_config_t netif_cfg = ESP_NETIF_DEFAULT_ETH();
    esp_netif_t *eth_netif = esp_netif_new(&netif_cfg);

    eth_mac_config_t mac_config = ETH_MAC_DEFAULT_CONFIG();
    eth_esp32_emac_config_t emac_config = ETH_ESP32_EMAC_DEFAULT_CONFIG();
    emac_config.smi_gpio.mdc_num = ETH_MDC_GPIO;
    emac_config.smi_gpio.mdio_num = ETH_MDIO_GPIO;

    esp_eth_mac_t *mac = esp_eth_mac_new_esp32(&emac_config, &mac_config);

    eth_phy_config_t phy_config = ETH_PHY_DEFAULT_CONFIG();
    phy_config.phy_addr = ETH_PHY_ADDR;
    phy_config.reset_gpio_num = ETH_PHY_RST_GPIO;

    esp_eth_phy_t *phy = esp_eth_phy_new_ip101(&phy_config);

    esp_eth_config_t eth_config = ETH_DEFAULT_CONFIG(mac, phy);
    esp_eth_handle_t eth_handle = NULL;

    ESP_LOGI(TAG, "Installing Ethernet driver (PHY=IP101GRI, MDC=%d, MDIO=%d, RST=%d, addr=%d)...",
             ETH_MDC_GPIO, ETH_MDIO_GPIO, ETH_PHY_RST_GPIO, ETH_PHY_ADDR);

    esp_err_t ret = esp_eth_driver_install(&eth_config, &eth_handle);
    if (ret != ESP_OK) {
        ESP_LOGE(TAG, "esp_eth_driver_install failed: %s (0x%x)", esp_err_to_name(ret), ret);
        ESP_LOGE(TAG, "Check: PoE hat connected? PHY powered? RJ45 cable seated?");
        return ret;
    }

    ESP_ERROR_CHECK(esp_netif_attach(eth_netif, esp_eth_new_netif_glue(eth_handle)));

    ESP_ERROR_CHECK(esp_event_handler_register(ETH_EVENT, ESP_EVENT_ANY_ID,
                                               &eth_event_handler, NULL));
    ESP_ERROR_CHECK(esp_event_handler_register(IP_EVENT, IP_EVENT_ETH_GOT_IP,
                                               &got_ip_event_handler, NULL));

    ESP_ERROR_CHECK(esp_eth_start(eth_handle));

    ESP_LOGI(TAG, "Ethernet started, DHCP in progress (non-blocking)");

    return ESP_OK;
}
