## animated-journey/firmware/scanner-p4/sdkconfig.defaults
```kconfig
CONFIG_IDF_TARGET="esp32p4"

# BLE via NimBLE (observer-only for passive scanning)
# Controller runs on the C6 co-processor, not locally on P4
CONFIG_BT_ENABLED=y
CONFIG_BT_CONTROLLER_DISABLED=y
CONFIG_BT_NIMBLE_ENABLED=y
CONFIG_BT_NIMBLE_ROLE_BROADCASTER=n
CONFIG_BT_NIMBLE_ROLE_PERIPHERAL=n
CONFIG_BT_NIMBLE_ROLE_CENTRAL=n
CONFIG_BT_NIMBLE_ROLE_OBSERVER=y
CONFIG_BT_NIMBLE_TRANSPORT_UART=n

# Partition table
CONFIG_PARTITION_TABLE_CUSTOM=y
CONFIG_PARTITION_TABLE_CUSTOM_FILENAME="partitions.csv"
CONFIG_ESPTOOLPY_FLASHSIZE_16MB=y

# ESP-Hosted: ESP32-C6 co-processor over SDIO
CONFIG_ESP_WIFI_REMOTE_LIBRARY_HOSTED=y
CONFIG_ESP_HOSTED_SDIO_HOST_INTERFACE=y
CONFIG_ESP_HOSTED_SDIO_CLOCK_FREQ_KHZ=40000
CONFIG_ESP_HOSTED_SDIO_BUS_WIDTH=4
CONFIG_ESP_HOSTED_SDIO_TX_Q_SIZE=60
CONFIG_ESP_HOSTED_SDIO_RX_Q_SIZE=60
CONFIG_ESP_HOSTED_ENABLE_BT_NIMBLE=y

# Ethernet (IP101GRI PHY via RMII)
CONFIG_ESP_ETH_ENABLED=y
CONFIG_ETH_USE_ESP32_EMAC=y

# Network
CONFIG_LWIP_SNTP_MAX_SERVERS=3

# Audio codec (ES8311 on I2C for speaker output)
CONFIG_CODEC_ES8311_SUPPORT=y

# FreeRTOS
CONFIG_FREERTOS_HZ=1000
```

## burtooth-mesh/firmware/scanner-c6/sdkconfig.defaults
```kconfig
CONFIG_BT_ENABLED=y
CONFIG_BT_NIMBLE_ENABLED=y
CONFIG_BT_NIMBLE_ROLE_BROADCASTER=n
CONFIG_BT_NIMBLE_ROLE_PERIPHERAL=n
CONFIG_BT_NIMBLE_ROLE_CENTRAL=n
CONFIG_BT_NIMBLE_ROLE_OBSERVER=y
CONFIG_PARTITION_TABLE_CUSTOM=y
CONFIG_PARTITION_TABLE_CUSTOM_FILENAME="partitions.csv"
CONFIG_ESPTOOLPY_FLASHSIZE_4MB=y
CONFIG_LWIP_SNTP_MAX_SERVERS=3
CONFIG_IEEE802154_ENABLED=y
```
